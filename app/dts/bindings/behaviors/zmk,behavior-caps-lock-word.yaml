## app/dts/bindings/behaviors/zmk,behavior-caps-lock-word.yaml
```yaml
# Copyright (c) 2021 The ZMK Contributors
# SPDX-License-Identifier: MIT

description: Caps lock word behavior

compatible: "zmk,behavior-caps-lock-word"

include: zero_param.yaml

properties:
  continue-list:
    type: array
    required: true
```

## app/dts/bindings/zmk,input-listener.yaml
```yaml
# Copyright (c) 2024 The ZMK Contributors
# SPDX-License-Identifier: MIT

description: |
  Listener to subscribe to input events and send HID updates after processing

compatible: "zmk,input-listener"

properties:
  device:
    type: phandle
    required: true
  input-processors:
    type: phandle-array
  zmk,separate-mouse-device:
    type: boolean
    description: Route this listener's mouse events to a separate HID mouse interface

child-binding:
  description: "Listener overrides for certain layers"

  properties:
    layers:
      type: array
      required: true
    process-next:
      type: boolean
    input-processors:
      type: phandle-array
```
