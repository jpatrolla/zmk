/*
 * Copyright (c) 2021 The ZMK Contributors
 *
 * SPDX-License-Identifier: MIT
 */

#include <dt-bindings/zmk/behaviors.h>
#include <dt-bindings/zmk/keys.h>

/ {
    behaviors {
#if ZMK_BEHAVIOR_OMIT(CAPS_LOCK_WORD)
        /omit-if-no-ref/
#endif
        caps_lock_word: caps_lock_word {
            compatible = "zmk,behavior-caps-lock-word";
            #binding-cells = <0>;
            continue-list = <UNDERSCORE BACKSPACE DELETE>;
            display-name = "Caps Lock Word";
        };
    };
};
